## board/rockchip/boox-c67ml/Kconfig
```kconfig
if TARGET_BOOX_C67ML

config SYS_BOARD
	default "boox-c67ml"

config SYS_VENDOR
	default "rockchip"

config SYS_CONFIG_NAME
	default "boox_c67ml"

endif
```

## board/rockchip/boox-rc2/Kconfig
```kconfig
if TARGET_BOOX_RC2

config SYS_BOARD
	default "boox-rc2"

config SYS_VENDOR
	default "rockchip"

config SYS_CONFIG_NAME
	default "boox_rc2"

endif
```

## configs/boox_rc2_defconfig
```kconfig
CONFIG_ARM=y
CONFIG_SKIP_LOWLEVEL_INIT_ONLY=y
CONFIG_SPL_SKIP_LOWLEVEL_INIT_ONLY=y
# CONFIG_SPL_USE_ARCH_MEMCPY is not set
# CONFIG_SPL_USE_ARCH_MEMSET is not set
CONFIG_ARCH_ROCKCHIP=y
CONFIG_TEXT_BASE=0x60000000
CONFIG_SPL_LIBCOMMON_SUPPORT=y
CONFIG_SPL_LIBGENERIC_SUPPORT=y
CONFIG_NR_DRAM_BANKS=1
CONFIG_HAS_CUSTOM_SYS_INIT_SP_ADDR=y
CONFIG_CUSTOM_SYS_INIT_SP_ADDR=0x60100000
CONFIG_DEFAULT_DEVICE_TREE="rk3026-onyx-rc2"
CONFIG_ROCKCHIP_RK3026=y
CONFIG_SPL_ROCKCHIP_BACK_TO_BROM=y
# CONFIG_SPL_SERIAL is not set
CONFIG_TARGET_BOOX_RC2=y
CONFIG_SPL_STACK_R_ADDR=0x80000
CONFIG_SPL_STACK=0x10081fff
CONFIG_SPL_TEXT_BASE=0x10080800
CONFIG_SPL_STACK_R=y
CONFIG_SYS_LOAD_ADDR=0x61000000
CONFIG_PRE_CON_BUF_ADDR=0x60f00000
CONFIG_PRE_CON_BUF_SZ=8192
# CONFIG_EFI_LOADER is not set
CONFIG_BOOTSTAGE=y
CONFIG_BOOTSTAGE_REPORT=y
CONFIG_BOOTDELAY=-1
CONFIG_DEFAULT_FDT_FILE="rk3026-onyx-rc2.dtb"
CONFIG_PRE_CONSOLE_BUFFER=y
CONFIG_CONSOLE_MUX=y
# CONFIG_DISPLAY_CPUINFO is not set
# CONFIG_DISPLAY_BOARDINFO is not set
CONFIG_CYCLIC=y
CONFIG_SPL_CYCLIC=y
CONFIG_BOARD_EARLY_INIT_F=y
# CONFIG_SPL_FRAMEWORK is not set
CONFIG_SPL_NO_BSS_LIMIT=y
CONFIG_SPL_HAVE_INIT_STACK=y
CONFIG_CMD_STRINGS=y
CONFIG_CMD_CLK=y
CONFIG_CMD_MMC=y
CONFIG_CMD_CACHE=y
CONFIG_CMD_PSTORE=y
CONFIG_CMD_PSTORE_MEM_ADDR=0x7ff40000
CONFIG_CMD_PSTORE_MEM_SIZE=0x80000
CONFIG_CMD_PSTORE_RECORD_SIZE=0x20000
CONFIG_CMD_PSTORE_CONSOLE_SIZE=0x40000
CONFIG_CMD_PSTORE_FTRACE_SIZE=0x0
CONFIG_CMD_PSTORE_PMSG_SIZE=0x0
CONFIG_CMD_BOOTSTAGE=y
# CONFIG_SPL_DOS_PARTITION is not set
# CONFIG_SPL_EFI_PARTITION is not set
CONFIG_NO_NET=y
CONFIG_SYSCON=y
# CONFIG_ADC is not set
CONFIG_CLK=y
# CONFIG_USB_FUNCTION_FASTBOOT is not set
# CONFIG_I2C is not set
CONFIG_MMC_DW=y
CONFIG_MMC_DW_ROCKCHIP=y
# CONFIG_MTD is not set
CONFIG_PINCTRL=y
# CONFIG_DM_REGULATOR is not set
# CONFIG_DM_PWM is not set
CONFIG_SYS_NS16550_MEM32=y
# CONFIG_SPI is not set
CONFIG_SYSRESET=y
# CONFIG_SPL_SYSRESET is not set
CONFIG_TIMER=y
CONFIG_ROCKCHIP_TIMER=y
CONFIG_ARM_GLOBAL_TIMER=y
CONFIG_USB=y
CONFIG_USB_GADGET=y
CONFIG_USB_GADGET_MANUFACTURER="ONYX"
CONFIG_USB_GADGET_PRODUCT_NUM=0x0010
CONFIG_USB_GADGET_DWC2_OTG=y
CONFIG_USB_GADGET_DOWNLOAD=y
CONFIG_USB_FUNCTION_ACM=y
CONFIG_SPL_TINY_MEMSET=y
```
